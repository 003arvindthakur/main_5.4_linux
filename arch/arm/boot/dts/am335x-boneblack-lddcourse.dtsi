/ {
    bone_gpio_devs {
        compatible = "org,bone-gpio-sysfs";
    gpio1@1{
            label = "userled0";
            bone-gpios = <&gpio1 21 GPIO_ACTIVE_HIGH>;
    };
    gpio1@2{
            label = "userled1";
            bone-gpios = <&gpio2 22 GPIO_ACTIVE_HIGH>;
        };
    };
};